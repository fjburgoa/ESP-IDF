#include <stdio.h>
#include "freertos/FreeRTOS.h"
#include "freertos/task.h"
#include "driver/gpio.h"
#include "driver/i2c.h"
#include "esp_log.h"

// I2C Configuration
#define I2C_MASTER_SCL_IO           GPIO_NUM_9
#define I2C_MASTER_SDA_IO           GPIO_NUM_8
#define I2C_MASTER_NUM              I2C_NUM_0
#define I2C_MASTER_FREQ_HZ          400000
#define I2C_MASTER_TX_BUF_DISABLE   0
#define I2C_MASTER_RX_BUF_DISABLE   0

// SH1106 Configuration
#define SH1106_I2C_ADDRESS          0x3C
#define SH1106_WIDTH                128
#define SH1106_HEIGHT               64
#define SH1106_PAGE_HEIGHT          8

// SH1106 Commands
#define SH1106_SET_CONTRAST         0x81
#define SH1106_SET_SEG_REMAP        0xA0
#define SH1106_SET_DISPLAY_ON       0xAF
#define SH1106_SET_DISPLAY_OFF      0xAE
#define SH1106_SET_DISPLAY_NORMAL   0xA6
#define SH1106_SET_MULTIPLEX        0xA8
#define SH1106_SET_DISPLAY_OFFSET   0xD3
#define SH1106_SET_START_LINE       0x40
#define SH1106_SET_CHARGE_PUMP      0x8D
#define SH1106_SET_MEMORY_MODE      0x20
#define SH1106_SET_COL_ADDR_HIGH    0x10
#define SH1106_SET_COL_ADDR_LOW     0x00
#define SH1106_SET_PAGE_ADDR        0xB0
#define SH1106_SET_COM_SCAN_NORMAL  0xC0
#define SH1106_SET_COM_SCAN_REMAP   0xC8
#define SH1106_SET_DISPLAY_CLOCK    0xD5
#define SH1106_SET_PRECHARGE        0xD9
#define SH1106_SET_COM_PINS         0xDA
#define SH1106_SET_VCOM_DESELECT    0xDB

static const char *TAG = "SH1106";

// Your compass bitmap (64x64 pixels)
const uint8_t compass_bitmap[64*64] = {
0x00, 0x00, 0x00, 0x00, 0x00, 0x00, 0x00, 0x07, 0x00, 0x00, 0x00, 0x00, 0x00, 0x00, 0x00, 0x07, 
0x00, 0x00, 0x00, 0x00, 0x00, 0x00, 0x00, 0x07, 0x00, 0x00, 0x00, 0x00, 0x00, 0x00, 0x00, 0x38, 
0x00, 0x00, 0x00, 0x00, 0x00, 0x00, 0x00, 0x38, 0x00, 0x00, 0x00, 0x00, 0x00, 0x00, 0x00, 0x38, 
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0xff, 0xff, 0xff, 0xff, 0x00, 0x00, 0x00, 0x00, 0xff, 0xff, 0xff, 0xff, 0x00, 0x00, 0x00, 0x00
};

// I2C Master initialization
static esp_err_t i2c_master_init(void) {
    i2c_config_t conf = {
        .mode = I2C_MODE_MASTER,
        .sda_io_num = I2C_MASTER_SDA_IO,
        .scl_io_num = I2C_MASTER_SCL_IO,
        .sda_pullup_en = GPIO_PULLUP_ENABLE,
        .scl_pullup_en = GPIO_PULLUP_ENABLE,
        .master.clk_speed = I2C_MASTER_FREQ_HZ,
    };

    esp_err_t ret = i2c_param_config(I2C_MASTER_NUM, &conf);
    if (ret != ESP_OK) {
        return ret;
    }

    return i2c_driver_install(I2C_MASTER_NUM, conf.mode, 
                             I2C_MASTER_RX_BUF_DISABLE, 
                             I2C_MASTER_TX_BUF_DISABLE, 0);
}

// Send command to SH1106
static void sh1106_send_command(uint8_t command) {
    uint8_t buf[2] = {0x00, command}; // Control byte (0x00 for command) + command
    i2c_master_write_to_device(I2C_MASTER_NUM, SH1106_I2C_ADDRESS, buf, sizeof(buf), 1000 / portTICK_PERIOD_MS);
}

// Send data to SH1106
static void sh1106_send_data(uint8_t *data, size_t len) {
    uint8_t *buf = malloc(len + 1);
    if (buf == NULL) {
        ESP_LOGE(TAG, "Failed to allocate buffer for data");
        return;
    }
    
    buf[0] = 0x40; // Control byte (0x40 for data)
    memcpy(buf + 1, data, len);
    
    i2c_master_write_to_device(I2C_MASTER_NUM, SH1106_I2C_ADDRESS, buf, len + 1, 1000 / portTICK_PERIOD_MS);
    
    free(buf);
}

// Initialize SH1106
static void sh1106_init(void) {
    // Wait for the display to power up
    vTaskDelay(100 / portTICK_PERIOD_MS);
    
    sh1106_send_command(SH1106_SET_DISPLAY_OFF);
    sh1106_send_command(SH1106_SET_MULTIPLEX);
    sh1106_send_command(0x3F); // 64-1
    sh1106_send_command(SH1106_SET_DISPLAY_OFFSET);
    sh1106_send_command(0x00);
    sh1106_send_command(SH1106_SET_START_LINE | 0x00);
    sh1106_send_command(SH1106_SET_SEG_REMAP | 0x01); // Reverse scan direction
    sh1106_send_command(SH1106_SET_COM_SCAN_REMAP); // Reverse COM scan direction
    sh1106_send_command(SH1106_SET_COM_PINS);
    sh1106_send_command(0x12);
    sh1106_send_command(SH1106_SET_CONTRAST);
    sh1106_send_command(0xFF);
    sh1106_send_command(SH1106_SET_DISPLAY_NORMAL);
    sh1106_send_command(SH1106_SET_DISPLAY_CLOCK);
    sh1106_send_command(0x80);
    sh1106_send_command(SH1106_SET_CHARGE_PUMP);
    sh1106_send_command(0x14);
    sh1106_send_command(SH1106_SET_MEMORY_MODE);
    sh1106_send_command(0x00); // Horizontal addressing mode
    sh1106_send_command(SH1106_SET_PRECHARGE);
    sh1106_send_command(0xF1);
    sh1106_send_command(SH1106_SET_VCOM_DESELECT);
    sh1106_send_command(0x40);
    sh1106_send_command(SH1106_SET_DISPLAY_ON);
    
    ESP_LOGI(TAG, "SH1106 initialized");
}

// Clear the display
static void sh1106_clear(void) {
    uint8_t zero_buffer[SH1106_WIDTH] = {0};
    
    for (uint8_t page = 0; page < SH1106_HEIGHT / SH1106_PAGE_HEIGHT; page++) {
        sh1106_send_command(SH1106_SET_PAGE_ADDR | page);
        sh1106_send_command(SH1106_SET_COL_ADDR_LOW | 0x00);
        sh1106_send_command(SH1106_SET_COL_ADDR_HIGH | 0x00);
        
        sh1106_send_data(zero_buffer, SH1106_WIDTH);
    }
}

// Display the compass bitmap centered on the screen
static void sh1106_display_bitmap(const uint8_t *bitmap) {
    // Calculate centering offset (SH1106 is 128x64, bitmap is 64x64)
    uint8_t x_offset = (SH1106_WIDTH - 64) / 2;
    
    for (uint8_t page = 0; page < 8; page++) { // 64 pixels / 8 = 8 pages
        sh1106_send_command(SH1106_SET_PAGE_ADDR | page);
        sh1106_send_command(SH1106_SET_COL_ADDR_LOW | (x_offset & 0x0F));
        sh1106_send_command(SH1106_SET_COL_ADDR_HIGH | ((x_offset >> 4) & 0x0F));
        
        // Send one row (64 pixels = 8 bytes) of the bitmap for this page
        sh1106_send_data((uint8_t*)&bitmap[page * 8], 8);
    }
}

void app_main(void) {
    ESP_LOGI(TAG, "Starting SH1106 compass display");
    
    // Initialize I2C
    ESP_ERROR_CHECK(i2c_master_init());
    ESP_LOGI(TAG, "I2C initialized successfully");
    
    // Initialize SH1106
    sh1106_init();
    
    // Clear display
    sh1106_clear();
    ESP_LOGI(TAG, "Display cleared");
    
    // Display the compass bitmap
    sh1106_display_bitmap(compass_bitmap);
    ESP_LOGI(TAG, "Compass bitmap displayed");
    
    // Keep the program running
    while (1) {
        vTaskDelay(1000 / portTICK_PERIOD_MS);
    }
}